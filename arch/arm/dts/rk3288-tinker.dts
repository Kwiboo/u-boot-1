// SPDX-License-Identifier: GPL-2.0+ OR X11
/*
 * (C) Copyright 2016 Rockchip Electronics Co., Ltd
 */

/dts-v1/;

#include "rk3288-tinker.dtsi"

/ {
	model = "Rockchip RK3288 Asus Tinker Board";
	compatible = "asus,rk3288-tinker", "rockchip,rk3288-tinker", "rockchip,rk3288";

	chosen {
		stdout-path = &uart2;
	};
};
